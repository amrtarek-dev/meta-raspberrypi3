## conf/bblayers.conf.sample
```bitbake
# POKY_BBLAYERS_CONF_VERSION is increased each time build/conf/bblayers.conf
# changes incompatibly
POKY_BBLAYERS_CONF_VERSION = "2"

BBPATH = "${TOPDIR}"
BBFILES ?= ""

BBLAYERS ?= " \
  /home/amr/yocto/poky/meta \
  /home/amr/yocto/poky/meta-poky \
  /home/amr/yocto/poky/meta-yocto-bsp \
  /home/amr/yocto/meta-raspberrypi \
  /home/amr/yocto/meta-rpi3 \
  "
```

## conf/layer.conf
```bitbake
# We have a conf and classes directory, add to BBPATH
BBPATH .= ":${LAYERDIR}"

# We have recipes-* directories, add to BBFILES
BBFILES += "${LAYERDIR}/recipes-*/*/*.bb \
            ${LAYERDIR}/recipes-*/*/*.bbappend"

BBFILE_COLLECTIONS += "meta-rpi3"
BBFILE_PATTERN_meta-rpi3 = "^${LAYERDIR}/"
BBFILE_PRIORITY_meta-rpi3 = "6"

LAYERDEPENDS_meta-rpi3 = "core"
LAYERSERIES_COMPAT_meta-rpi3 = "warrior zeus"

# Depends on meta-raspberripi
LAYERDEPENDS_meta-raspberrypi = "core"
```
